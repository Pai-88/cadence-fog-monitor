/*
  ═══════════════════════════════════════════════════════════════════════════
  !! NOT THE SUBMITTED BUILD — closed-loop CNN *cueing* prototype (ESP32-S3, stretch).
  !! The submitted Cadence device is the MONITOR sketch, cue disabled:
  !!   firmware/variants/cpx_fog_standalone/cpx_fog_standalone.ino
  esp32_s3_fog.ino  —  ESP32-S3 mini  ·  on-body FoG CNN "brain"
  Parkinson's closed-loop gait garment  ·  ENGF0031 Scenario 2  (STRETCH)
  ═══════════════════════════════════════════════════════════════════════════

  WHAT THIS BOARD DOES
      It runs the trained FoG convolutional network ON THE BODY, in int8, with
      no laptop in the loop:

          CPX accel  ──UART──▶  S3 (filter → CNN → gate)  ──UART──▶  CPX motor

      The Circuit Playground Express cannot host the CNN (48 MHz M0+, 32 KB RAM,
      no FPU). The ESP32-S3 can: 240 MHz dual-core, FPU, ≥512 KB SRAM — plenty
      for an ~18 k-parameter int8 model in TensorFlow Lite Micro. So we split the
      garment into a SENSOR/ACTUATOR node (the CPX) and a CNN co-processor (this
      S3), joined by one 3-wire UART link.

  ROLE SPLIT  (the CPX keeps doing what it already does well)
      CPX  : samples its onboard LIS3DH at 64 Hz and streams "ax,ay,az\n"
             (int16 milli-g) to this board; pulses the coin motor at CUE_HZ
             whenever it is in the cue state.
      S3   : buffers the stream, and every HOP samples (2 s) runs the exact
             training signal chain — per-window zero-phase band-pass, per-axis
             z-score, int8 CNN — to get P(freeze). A movement-energy gate then
             suppresses cues when the wearer is not actually moving. On a
             debounced state change it sends one cue byte back to the CPX:
                 'C' = start cueing      'S' = stop cueing
             (matches fog/config.py CUE_ON / CUE_OFF.)

      The CPX side therefore needs a sketch that BOTH streams accel AND drives
      the motor on 'C'/'S' (a streamer + a 2-byte cue receiver). That is the
      counterpart to this file; cpx_fog_standalone shows the motor/cue code to
      reuse, cpx_fog_streamer shows the streaming half.

  WHY THE NUMBERS BELOW ARE TRUSTWORTHY
      The model and its preprocessing were frozen offline. The int8 .tflite is
      produced by colab/export_fog_tflite.py (TensorFlow has no wheel for the
      project's Python 3.14, so conversion runs in Colab). That script also
      reports the sensitivity/specificity of the int8 model under THIS board's
      per-window filter — that figure, not the offline LOSO number, is what to
      expect here. The band-pass coefficients, the z-score stats, and the gate
      filters in the EXPORTED block were all settled locally (fog_filter_probe)
      against the same algorithm this firmware runs, so they transfer exactly.

  ── HARDWARE / WIRING ──
      Board  : any ESP32-S3 mini (e.g. Lolin S3 Mini). No IMU needed on the S3 —
               the CPX is the sensor.
      Link   : CPX hardware-UART TX ──▶ S3 PIN_RX (GPIO18)
               S3 PIN_TX (GPIO17)   ──▶ CPX hardware-UART RX
               common GND between the two boards. 115200 8N1.
               (GPIO17/18 are safe on the S3 — they are not strapping pins
               0/3/45/46 and not the USB pins 19/20.)
      Button : onboard BOOT button (GPIO0) = calibrate the still-floor. Stand
               still, press; or send 'k' over USB serial.
      LED    : onboard RGB (if the core defines RGB_BUILTIN) mirrors the CPX
               colour code for at-a-glance debug.
      Power  : the S3 can share the garment battery; it draws more than the CPX,
               so this is the "stretch" config, not the minimal one.

  ── BUILD ──
      Arduino IDE → ESP32-S3 board. Install an ESP32 TFLM library that provides
      the tensorflow/lite/micro headers (e.g. Espressif "esp-tflite-micro").
      Run colab/export_fog_tflite.py, then copy the generated fog_cnn_model.h
      next to THIS .ino before compiling.
  ═══════════════════════════════════════════════════════════════════════════
*/

#include <Arduino.h>
#include <math.h>
#include <stdlib.h>

// ── TensorFlow Lite Micro ──
#include "tensorflow/lite/micro/micro_interpreter.h"
#include "tensorflow/lite/micro/micro_mutable_op_resolver.h"
#include "tensorflow/lite/micro/system_setup.h"
#include "tensorflow/lite/schema/schema_generated.h"

// The int8 model byte-array, generated by colab/export_fog_tflite.py:
//   g_fog_model[]  +  g_fog_model_len
#if __has_include("fog_cnn_model.h")
#include "fog_cnn_model.h"
#else
#error "fog_cnn_model.h not found — run colab/export_fog_tflite.py and copy the generated header into this sketch folder."
#endif

// ╔═══════════════════════════════════════════════════════════════════════╗
// ║  EXPORTED / FROZEN CONSTANTS  (settled offline; see fog_filter_probe)  ║
// ╚═══════════════════════════════════════════════════════════════════════╝
#define FS         64        // sample rate of the incoming stream (Hz)
#define WINDOW     256       // CNN analysis window (samples) = 4.0 s
#define HOP        128       // decision cadence (samples)    = 2.0 s
#define N_AXES     3         // ax, ay, az
#define FREEZE_IDX 1         // labels = ['no_freeze','freeze'] → freeze is index 1

// One biquad section: {b0,b1,b2,a1,a2}, a0 normalised to 1 (as scipy SOS).
struct Sos { float b0, b1, b2, a1, a2; };

// ── CNN front-end band-pass: 0.5–15 Hz Butterworth order-4 → 4 sections.
//    This is the per-window stand-in for the training filtfilt; the CNN's
//    z-score stats below were learned on signal shaped by this exact band.
#define N_BP 4
const Sos BP_SOS[N_BP] = {
  //   b0            b1            b2            a1            a2
  {  0.06898870f,  0.13797740f,  0.06898870f, -0.15210232f,  0.04944658f },  // sec 0
  {  1.00000000f,  2.00000000f,  1.00000000f, -0.15439279f,  0.46737329f },  // sec 1
  {  1.00000000f, -2.00000000f,  1.00000000f, -1.90749478f,  0.91002529f },  // sec 2
  {  1.00000000f, -2.00000000f,  1.00000000f, -1.96215714f,  0.96455820f },  // sec 3
};

// ── per-axis z-score (channels-first order: ax, ay, az), in milli-g.
//    z = (filtered_mg - mean) / std.  Matches fog_norm.npz.
const float NORM_MEAN[N_AXES] = { -0.00209028f,  0.00042287f,  0.00499514f };
const float NORM_STD [N_AXES] = { 439.81107f,   312.45398f,   254.60650f   };

// ── movement-energy gate filters (run on the accel MAGNITUDE, Bachlin 2010).
//    Same coefficients as cpx_fog_standalone so the gate behaves identically.
#define N_GATE 2
const Sos FREEZE_SOS[N_GATE] = {            // 3–8 Hz
  { 0.04427971f,  0.08855942f, 0.04427971f, -1.24067070f, 0.62897179f },
  { 1.00000000f, -2.00000000f, 1.00000000f, -1.69751871f, 0.79495806f },
};
const Sos LOCO_SOS[N_GATE] = {              // 0.5–3 Hz
  { 0.01278734f,  0.02557469f, 0.01278734f, -1.69059402f, 0.75072617f },
  { 1.00000000f, -2.00000000f, 1.00000000f, -1.93848688f, 0.94143123f },
};
const Sos TREMOR_SOS[N_GATE] = {            // 4–6 Hz (tremor monitor, display only)
  { 0.00844269f,  0.01688539f, 0.00844269f, -1.57431617f, 0.85437745f },
  { 1.00000000f, -2.00000000f, 1.00000000f, -1.72565146f, 0.88666542f },
};
// ── end exported block ─────────────────────────────────────────────────────

// ── decision tuning ──
const float   FREEZE_PROB_THR = 0.5f;   // CNN P(freeze) decision boundary
const uint8_t CONFIRM_ON      = 2;      // consecutive freeze windows → cue ON
const uint8_t CONFIRM_OFF     = 2;      // consecutive clear  windows → cue OFF

// ── movement-energy gate: freeze ⟺ P(freeze)>THR AND (Pf+Pl) > still_floor.
//    Powers are computed on the magnitude in m/s² (we convert the incoming
//    milli-g to m/s² for the gate ONLY), so still_floor stays in the same
//    units as cpx_fog_standalone and its 2.0 default transfers. Press the BOOT
//    button (or send 'k') while standing to calibrate it to the wearer.
float        still_floor  = 2.0f;       // (re)set by calibration
const float  STILL_MARGIN = 4.0f;       // floor = margin × resting band power
const float  MIN_FLOOR    = 0.5f;       // floor never collapses toward 0
const float  MG_TO_MS2    = 9.80665f / 1000.0f;   // wire units (milli-g) → m/s²
const float  MS2SQ_TO_MG2 = 1.0f / (MG_TO_MS2 * MG_TO_MS2);  // (m/s²)² power → mg² (tremor)

// ── UART link to the CPX ──
const uint8_t  PIN_RX     = 18;         // ← CPX TX  (S3-safe GPIO)
const uint8_t  PIN_TX     = 17;         // → CPX RX
const uint32_t LINK_BAUD  = 115200;
const char     CUE_ON     = 'C';        // fog/config.py CUE_ON  (start motor)
const char     CUE_OFF    = 'S';        // fog/config.py CUE_OFF (stop motor)

// ── live laptop dashboard over USB (pi/s3_dashboard_bridge.py) ──
//    The S3 is plugged into the laptop over USB anyway, so it streams its OWN
//    output up that cable: the raw waveform per sample ("ax,ay,az") and one
//    decision line per window ("#D,STATE,prob,fi,tremor,energy,floor,cue"). The
//    bridge relays exactly this to dashboard.html — the screen shows what the
//    BOARD decided, not a laptop re-run of the model. Set 0 to silence it and
//    print human-readable debug instead.
#define USB_DASHBOARD 1

// ── optional: mirror waveform + decisions to the esp32_hub dashboard ──
//    Set to 1 and wire PIN_TLM_TX → hub RX2 to feed the live panels. The S3
//    forwards each "ax,ay,az" sample and emits "#STATE,prob" per decision.
#define TELEMETRY_TO_HUB 0
const uint8_t  PIN_TLM_TX = 16;
const uint32_t TLM_BAUD   = 115200;

// ── calibrate button (onboard BOOT button, active-low) ──
const uint8_t  PIN_BTN    = 0;

// ── TFLM working memory. The exporter prints an arena upper bound; 100 KB is a
//    safe ceiling for this model. Boot prints arena_used_bytes() so you can trim.
constexpr int kArenaSize = 100 * 1024;
alignas(16) static uint8_t tensor_arena[kArenaSize];

tflite::MicroInterpreter *interpreter = nullptr;
TfLiteTensor *input  = nullptr;
TfLiteTensor *output = nullptr;
float in_scale = 1.0f, out_scale = 1.0f;
int   in_zp = 0, out_zp = 0;

// ── ring buffers of the most-recent raw samples (milli-g), one per axis ──
float    ax_ring[WINDOW], ay_ring[WINDOW], az_ring[WINDOW];
uint16_t head = 0;          // index of the OLDEST sample once the buffer is full
uint16_t filled = 0;
uint16_t since_hop = 0;

// ── scratch windows (assembled oldest→newest each decision) ──
float axw[WINDOW], ayw[WINDOW], azw[WINDOW];   // ordered raw windows
float magw[WINDOW];                            // magnitude window (m/s²) for the gate
float fwin[WINDOW];                            // one filtered axis (reused per axis)

// ── runtime state ──
enum GaitState { STILL, WALKING, FREEZE };
GaitState g_state = WALKING;
bool      cueing = false;
uint8_t   on_count = 0, off_count = 0;
float     last_prob = 0.0f;       // last CNN P(freeze)
float     last_energy = 0.0f;     // last Pf+Pl (gate input)
float     g_pf = 0.0f, g_pl = 0.0f;
float     g_tremor = 0.0f;        // last 4–6 Hz tremor-band power, (m/s²)²
float     g_fi = 0.0f;            // last classical Freeze Index = Pf/Pl (dashboard panel)

// ── calibration / button-edge state ──
bool     calibrating = false;
uint16_t calib_left = 0;
bool     btn_prev = false;

// ── incoming-line parser state ──
char    linebuf[40];
uint8_t linelen = 0;

// ════════════════════════════════════════════════════════════════════════════
//  DSP helpers
// ════════════════════════════════════════════════════════════════════════════

// Reverse y[0..n-1] in place (the "back-filter" step of filtfilt).
static void reverseInPlace(float *y, int n) {
  for (int i = 0, j = n - 1; i < j; i++, j--) {
    float t = y[i]; y[i] = y[j]; y[j] = t;
  }
}

// Direct-Form-II-Transposed forward pass of an SOS cascade, in place on y[n],
// zero initial state. Mirrors _fwd() in fog_filter_probe / export_fog_tflite.
static void sosForward(const Sos *sos, uint8_t nsos, float *y, int n) {
  for (uint8_t s = 0; s < nsos; s++) {
    float z1 = 0.0f, z2 = 0.0f;
    const float b0 = sos[s].b0, b1 = sos[s].b1, b2 = sos[s].b2,
                a1 = sos[s].a1, a2 = sos[s].a2;
    for (int i = 0; i < n; i++) {
      float xin = y[i];
      float o = b0 * xin + z1;
      z1 = b1 * xin - a1 * o + z2;
      z2 = b2 * xin - a2 * o;
      y[i] = o;
    }
  }
}

// Per-window zero-phase filtfilt: odd-reflection pad, then forward, reverse,
// forward, reverse — the EXACT algorithm validated against scipy.filtfilt in
// fog_filter_probe (pad=32). in[WINDOW] → out[WINDOW].
#define PAD 32
static void sosFiltfilt(const Sos *sos, uint8_t nsos, const float *in, float *out) {
  static float buf[WINDOW + 2 * PAD];
  // left edge: odd reflection about in[0]  →  2*in[0] - in[PAD..1]
  for (int i = 0; i < PAD; i++)        buf[i] = 2.0f * in[0] - in[PAD - i];
  for (int i = 0; i < WINDOW; i++)     buf[PAD + i] = in[i];
  // right edge: odd reflection about in[W-1]  →  2*in[W-1] - in[W-2 .. W-PAD-1]
  for (int i = 0; i < PAD; i++)        buf[PAD + WINDOW + i] = 2.0f * in[WINDOW - 1] - in[WINDOW - 2 - i];

  const int n = WINDOW + 2 * PAD;
  sosForward(sos, nsos, buf, n);
  reverseInPlace(buf, n);
  sosForward(sos, nsos, buf, n);
  reverseInPlace(buf, n);
  for (int i = 0; i < WINDOW; i++) out[i] = buf[PAD + i];
}

// Streaming SOS cascade returning Σ y² over the window = band power. Identical
// to cpx_fog_standalone::runBand (the gate behaves the same as the validated
// classical detector). x[] is expected mean-removed.
static float runBand(const Sos *sos, uint8_t nsos, const float *x, int n) {
  float z1[N_GATE] = {0}, z2[N_GATE] = {0};
  float sumsq = 0.0f;
  for (int i = 0; i < n; i++) {
    float in = x[i];
    for (uint8_t s = 0; s < nsos; s++) {
      float o = sos[s].b0 * in + z1[s];
      z1[s] = sos[s].b1 * in - sos[s].a1 * o + z2[s];
      z2[s] = sos[s].b2 * in - sos[s].a2 * o;
      in = o;
    }
    sumsq += in * in;
  }
  return sumsq;
}

// ════════════════════════════════════════════════════════════════════════════
//  Window assembly + the two analyses (gate energy, CNN probability)
// ════════════════════════════════════════════════════════════════════════════

// Copy the ring buffers into ordered (oldest→newest) windows, and build the
// magnitude window in m/s² for the movement-energy gate.
static void assembleWindows() {
  for (uint16_t i = 0; i < WINDOW; i++) {
    uint16_t idx = (head + i) % WINDOW;     // head = oldest when full
    float ax = ax_ring[idx], ay = ay_ring[idx], az = az_ring[idx];
    axw[i] = ax; ayw[i] = ay; azw[i] = az;
    magw[i] = sqrtf(ax * ax + ay * ay + az * az) * MG_TO_MS2;  // milli-g → m/s²
  }
}

// Movement-energy gate: band powers of the (mean-removed) magnitude.
// Fills g_pf, g_pl; returns Pf+Pl.
static float gateEnergy() {
  float mean = 0.0f;
  for (uint16_t i = 0; i < WINDOW; i++) mean += magw[i];
  mean /= WINDOW;
  for (uint16_t i = 0; i < WINDOW; i++) magw[i] -= mean;
  g_pf = runBand(FREEZE_SOS, N_GATE, magw, WINDOW);   // 3–8 Hz
  g_pl = runBand(LOCO_SOS,   N_GATE, magw, WINDOW);   // 0.5–3 Hz
  g_tremor = runBand(TREMOR_SOS, N_GATE, magw, WINDOW);  // 4–6 Hz (monitoring only)
  return g_pf + g_pl;
}

// Run the int8 CNN on the current window: per-axis filtfilt → z-score →
// quantize → invoke → P(freeze). Mirrors the training/Colab signal chain.
static float cnnProbFreeze() {
  const float *src[N_AXES] = { axw, ayw, azw };
  for (uint8_t c = 0; c < N_AXES; c++) {
    sosFiltfilt(BP_SOS, N_BP, src[c], fwin);          // 0.5–15 Hz zero-phase
    const float mean = NORM_MEAN[c], sd = NORM_STD[c];
    for (uint16_t t = 0; t < WINDOW; t++) {
      float z = (fwin[t] - mean) / sd;                // per-axis z-score
      int q = (int)lroundf(z / in_scale) + in_zp;     // affine int8 quantize
      if (q < -128) q = -128; else if (q > 127) q = 127;
      // model input is channels-last (WINDOW, N_AXES) → flat index t*N_AXES + c
      input->data.int8[t * N_AXES + c] = (int8_t)q;
    }
  }
  if (interpreter->Invoke() != kTfLiteOk) return last_prob;   // keep last on error
  int8_t qf = output->data.int8[FREEZE_IDX];
  return ((int)qf - out_zp) * out_scale;              // dequantize → P(freeze)
}

// ════════════════════════════════════════════════════════════════════════════
//  Status LED (onboard RGB if the core exposes it) + cue link
// ════════════════════════════════════════════════════════════════════════════
static void showState() {
#ifdef RGB_BUILTIN
  uint8_t r = 0, g = 0, b = 0;
  if (calibrating)           { r = 0;  g = 0;  b = 40; }   // blue  = calibrating
  else if (cueing)           { r = 60; g = 0;  b = 0;  }   // red   = cueing
  else if (g_state == STILL) { r = 0;  g = 4;  b = 6;  }   // teal  = standing
  else                       { r = 0;  g = 22; b = 0;  }   // green = walking
  rgbLedWrite(RGB_BUILTIN, r, g, b);
#endif
}

// Send a cue byte to the CPX on a debounced state change only.
static void sendCue(char c) {
  Serial1.write(c);
}

// ════════════════════════════════════════════════════════════════════════════
//  Per-decision pipeline (called once every HOP samples, window full)
// ════════════════════════════════════════════════════════════════════════════
static void runDecision() {
  assembleWindows();

  // calibration: take ONE still window as the resting energy reference
  if (calibrating) {
    last_energy = gateEnergy();
    still_floor = STILL_MARGIN * last_energy;
    if (still_floor < MIN_FLOOR) still_floor = MIN_FLOOR;
    calibrating = false;
    Serial.print("calibrated: rest_energy="); Serial.print(last_energy, 3);
    Serial.print("  -> still_floor=");        Serial.println(still_floor, 3);
    showState();
    return;
  }

  last_energy = gateEnergy();                  // gate first (cheap), then CNN
  last_prob   = cnnProbFreeze();
  g_fi        = g_pf / (g_pl + 1e-9f);         // classical Freeze Index (dashboard panel)

  bool moving = last_energy > still_floor;      // is there real gait to freeze?
  bool freeze = moving && (last_prob > FREEZE_PROB_THR);
  g_state = !moving ? STILL : (freeze ? FREEZE : WALKING);

  if (freeze) { on_count++;  off_count = 0; }   // STILL & WALKING both "clear"
  else        { off_count++; on_count  = 0; }

  if (!cueing && on_count >= CONFIRM_ON) {
    cueing = true;  sendCue(CUE_ON);            // tell the CPX to start buzzing
  } else if (cueing && off_count >= CONFIRM_OFF) {
    cueing = false; sendCue(CUE_OFF);           // tell the CPX to stop
  }
  showState();

#if USB_DASHBOARD
  // one machine-readable decision line for s3_dashboard_bridge.py:
  //   #D,STATE,prob,fi,tremor(mg^2),energy,floor,cue
  Serial.print("#D,");
  Serial.print(g_state == STILL ? "STILL" : g_state == FREEZE ? "FREEZE" : "WALKING");
  Serial.print(',');  Serial.print(last_prob, 3);
  Serial.print(',');  Serial.print(g_fi, 3);
  Serial.print(',');  Serial.print(g_tremor * MS2SQ_TO_MG2, 1);
  Serial.print(',');  Serial.print(last_energy, 2);
  Serial.print(',');  Serial.print(still_floor, 2);
  Serial.print(',');  Serial.println(cueing ? 1 : 0);
#else
  // human-readable debug line over USB
  Serial.print("P(freeze)="); Serial.print(last_prob, 3);
  Serial.print(" E=");        Serial.print(last_energy, 2);
  Serial.print("/");          Serial.print(still_floor, 2);
  Serial.print(g_state == STILL ? "  STILL"
             : g_state == FREEZE ? "  FREEZE" : "  WALKING");
  if (cueing) Serial.print(" -> cue");
  Serial.println();
#endif

#if TELEMETRY_TO_HUB
  // "#STATE,prob" for the dashboard freeze panel (cf. standalone's "#STATE,FI")
  Serial2.print('#');
  Serial2.print(g_state == STILL ? "STILL" : g_state == FREEZE ? "FREEZE" : "WALKING");
  Serial2.print(',');
  Serial2.println(last_prob, 3);
#endif
}

// ════════════════════════════════════════════════════════════════════════════
//  Stream ingestion: parse "ax,ay,az" (int16 milli-g) lines from the CPX
// ════════════════════════════════════════════════════════════════════════════
static void pushSample(float ax, float ay, float az) {
  ax_ring[head] = ax; ay_ring[head] = ay; az_ring[head] = az;
  head = (head + 1) % WINDOW;
  if (filled < WINDOW) filled++;
  since_hop++;

  if (filled >= WINDOW && since_hop >= HOP) {
    since_hop = 0;
    runDecision();
  }
}

// Parse a null-terminated "int,int,int" line. Returns true on success.
static bool parse3(const char *s, long *a, long *b, long *c) {
  char *end;
  *a = strtol(s, &end, 10);     if (*end != ',') return false;
  *b = strtol(end + 1, &end, 10); if (*end != ',') return false;
  *c = strtol(end + 1, &end, 10);
  return true;
}

static void ingestLink() {
  while (Serial1.available()) {
    char ch = (char)Serial1.read();
    if (ch == '\n' || ch == '\r') {
      if (linelen > 0) {
        linebuf[linelen] = '\0';
        long ax, ay, az;
        if (parse3(linebuf, &ax, &ay, &az)) {
#if USB_DASHBOARD
          Serial.println(linebuf);           // echo raw waveform → laptop bridge
#endif
#if TELEMETRY_TO_HUB
          Serial2.println(linebuf);          // forward raw waveform to the hub
#endif
          pushSample((float)ax, (float)ay, (float)az);
        }
        linelen = 0;
      }
    } else if (linelen < sizeof(linebuf) - 1) {
      linebuf[linelen++] = ch;
    } else {
      linelen = 0;                            // overrun → drop the partial line
    }
  }
}

// ════════════════════════════════════════════════════════════════════════════
//  Calibration trigger (BOOT button or 'k' over USB serial)
// ════════════════════════════════════════════════════════════════════════════
static void startCalibration() {
  calibrating = true;
  filled = 0; since_hop = 0;                  // collect one fresh, full window
  cueing = false; sendCue(CUE_OFF);
  on_count = off_count = 0;
  Serial.println("calibrating still-floor: stand still ~4 s ...");
  showState();
}

static void checkCalibrateTriggers() {
  bool btn = (digitalRead(PIN_BTN) == LOW);   // BOOT button is active-low
  if (btn && !btn_prev && !calibrating) startCalibration();
  btn_prev = btn;

  if (Serial.available()) {
    char c = (char)Serial.read();
    if ((c == 'k' || c == 'K') && !calibrating) startCalibration();
  }
}

// ════════════════════════════════════════════════════════════════════════════
//  Setup
// ════════════════════════════════════════════════════════════════════════════
void setup() {
  Serial.begin(115200);                                   // USB debug / dashboard telemetry
#if USB_DASHBOARD && ARDUINO_USB_CDC_ON_BOOT
  Serial.setTxTimeoutMs(0);   // native-USB only: never block the closed loop if the laptop is absent
#endif
  Serial1.begin(LINK_BAUD, SERIAL_8N1, PIN_RX, PIN_TX);   // CPX link
#if TELEMETRY_TO_HUB
  Serial2.begin(TLM_BAUD, SERIAL_8N1, -1, PIN_TLM_TX);    // TX-only to the hub
#endif
  pinMode(PIN_BTN, INPUT_PULLUP);

  // ── bring up the int8 CNN ──
  const tflite::Model *model = tflite::GetModel(g_fog_model);
  if (model->version() != TFLITE_SCHEMA_VERSION) {
    Serial.print("FATAL: model schema "); Serial.print(model->version());
    Serial.print(" != supported ");        Serial.println(TFLITE_SCHEMA_VERSION);
    while (true) delay(1000);
  }

  // Register only the ops this graph uses. The exporter prints the authoritative
  // op list — if it names an op not added here, add it (and bump the template
  // size). Adding spares is harmless. Conv1D→CONV_2D, MaxPool1D→MAX_POOL_2D,
  // GAP→MEAN, Dense→FULLY_CONNECTED, plus SOFTMAX and the RESHAPE/(DE)QUANTIZE
  // the converter inserts for the int8 boundaries.
  static tflite::MicroMutableOpResolver<10> resolver;
  resolver.AddConv2D();
  resolver.AddMaxPool2D();
  resolver.AddMean();
  resolver.AddFullyConnected();
  resolver.AddSoftmax();
  resolver.AddReshape();
  resolver.AddExpandDims();   // export wraps the 1-D conv as 2-D, so the graph has EXPAND_DIMS
  resolver.AddQuantize();
  resolver.AddDequantize();

  static tflite::MicroInterpreter static_interpreter(
      model, resolver, tensor_arena, kArenaSize);
  interpreter = &static_interpreter;

  if (interpreter->AllocateTensors() != kTfLiteOk) {
    Serial.println("FATAL: AllocateTensors failed — arena too small or missing op.");
    while (true) delay(1000);
  }

  input  = interpreter->input(0);
  output = interpreter->output(0);
  in_scale  = input->params.scale;   in_zp  = input->params.zero_point;
  out_scale = output->params.scale;  out_zp = output->params.zero_point;

  Serial.println("\nESP32-S3 FoG CNN brain ready.");
  Serial.print("  arena used : "); Serial.print(interpreter->arena_used_bytes());
  Serial.print(" / ");             Serial.print(kArenaSize); Serial.println(" bytes");
  Serial.print("  input dims :");
  for (int i = 0; i < input->dims->size; i++) { Serial.print(' '); Serial.print(input->dims->data[i]); }
  Serial.print("  type="); Serial.println(input->type == kTfLiteInt8 ? "int8" : "OTHER!");
  Serial.print("  in  q: scale="); Serial.print(in_scale, 8);  Serial.print(" zp="); Serial.println(in_zp);
  Serial.print("  out q: scale="); Serial.print(out_scale, 8); Serial.print(" zp="); Serial.println(out_zp);
  Serial.println("  hold still + press BOOT (or send 'k') to calibrate the gate.\n");

  showState();
}

// ════════════════════════════════════════════════════════════════════════════
//  Loop — purely event-driven: the CPX is the sample clock, we just consume it
// ════════════════════════════════════════════════════════════════════════════
void loop() {
  ingestLink();              // parse incoming accel; runs a decision every HOP
  checkCalibrateTriggers();  // BOOT button / 'k'
}
